// Settings for TFT
#include <Adafruit_GFX.h>    // Core graphics library
#include <Adafruit_ST7735.h> // Hardware-specific library for ST7735
#include <Adafruit_ST7789.h> // Hardware-specific library for ST7789
#include <SPI.h>
#include <string.h>


#if defined(ARDUINO_FEATHER_ESP32) // Feather Huzzah32
  #define TFT_CS         14
  #define TFT_RST        15
  #define TFT_DC         32

#elif defined(ESP8266)
  #define TFT_CS         4
  #define TFT_RST        16                                            
  #define TFT_DC         5

#else
  // For the breakout board, you can use any 2 or 3 pins.
  // These pins will also work for the 1.8" TFT shield.
  #define TFT_CS        10
  #define TFT_RST        9 // Or set to -1 and connect to Arduino RESET pin
  #define TFT_DC         8
#endif

Adafruit_ST7735 tft = Adafruit_ST7735(TFT_CS, TFT_DC, TFT_RST);

// SPEAKER SETTINGS
int speakerPin=4;
char notes[]="cdefgabCbagdedc";
int beats[]= {1,1,1,1,1,1,2,1,1,1,1,2,4,8,4};
int tempo=300;

// ULtRASSONS SETTINGS
#define trigPin 3
#define echoPin 2

//BUTTONS SETTINGS
const int botaoAlarm = 6;
const int botaoSettings = 7;

//MILLIS SETTINGS
unsigned long startMillis;
unsigned long currentMillis;

//CLOCK SETTINGS
unsigned long h=0;
unsigned long m=0;
int s=0;
unsigned long d=1;
//Time Variables
int HauxI=0;
int HauxF=0;
int MauxI=0;
int MauxF=0;
int timemode=0;

// GLOBAL VARIABLES
int modoAlarme=0;
int luz=1;
int ldrmode=0;

//Report variables
int ReportHour[10];
int ReportMin[10];
int ReportDay[10];
int ReportNum;
int alarmNum=0;

void setup() {
  // put your setup code here, to run once:
  Serial.begin(9600);
  tft.initR(INITR_144GREENTAB);
  pinMode(speakerPin, OUTPUT);
  pinMode(trigPin, OUTPUT);
	pinMode(echoPin, INPUT);
  pinMode(botaoAlarm,INPUT);
  startMillis=millis();
}


// ULTRASSONS FUNCTION
long measureDistance() {
	long duration, distance;
  //Send pulse
	digitalWrite(trigPin, LOW);
	delayMicroseconds(2);
	digitalWrite(trigPin, HIGH);
	delayMicroseconds(10);
	digitalWrite(trigPin, LOW);
  //Wait for echo and measure time until it happens
	duration = pulseIn(echoPin, HIGH);
	//Compute distance
	distance = duration/58;
  return distance;
}


//SPEAKER FUNCTIONS
void playTone(int tone, int duration){              
  for(long i=0; i<duration*1000L; i+= tone*2) {
    digitalWrite(speakerPin, HIGH);
    delayMicroseconds(tone);
    digitalWrite(speakerPin, LOW);
    delayMicroseconds(tone);
  }
}

void playNote(char note, int duration){                
  char names[]={'c','d','e','f','g', 'a', 'b', 'C' };
  int tones[]={1915,1700,1519,1432,1275,1136,1014,956};
  for(int i=0; i<8; i++)
    if(names[i] == note)
      playTone(tones[i],duration);
}

//BACKGROUND IMAGE
const uint16_t background[5072] PROGMEM={
0x2AF5, 0x2AF5, 0x2AF5, 0x2AF5, 0x2AF5, 0x2AF5, 0x2AF5, 0x2AD5, 0x2AD5, 0x2AD5, 0x2AD5, 0x2AD5, 0x2AD5, 0x2AD5, 0x2AD5, 0x2AD5,   // 0x0010 (16) pixels
0x2AD4, 0x2AD4, 0x2AD4, 0x2AD4, 0x2AD4, 0x2AD4, 0x2AD4, 0x2AD4, 0x2AD4, 0x2AD4, 0x2AD4, 0x2AD4, 0x2AD4, 0x2AD4, 0x2AD4, 0x2AD4,   // 0x0020 (32) pixels
0x2AD4, 0x2AD4, 0x2AD4, 0x2AB4, 0x2AB4, 0x2AB4, 0x2AB4, 0x2AB4, 0x2AB4, 0x2AB4, 0x2AB4, 0x2AB4, 0x2AB4, 0x2AB4, 0x2AB4, 0x2AB4,   // 0x0030 (48) pixels
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0x2293, 0x2293, 0x2293, 0x2293, 0x2293, 0x2A93, 0x2A73, 0x2A73, 0x2A73, 0x2A73, 0x2A73, 0x2A73, 0x2A73, 0x2A73, 0x2A73, 0x2A73,   // 0x13D0 (5072) pixels
};


// PRINT/DISPLAY FUNCTIONS
void displayAlarm(int16_t x, int16_t y,uint8_t size, uint16_t color){
  tft.setCursor(x,y);
  tft.setTextColor(color);
  tft.setTextSize(size);
  tft.print("Alarme");
};

void displaySettings(int16_t x, int16_t y,uint8_t size, uint16_t color){
  tft.setCursor(x,y);
  tft.setTextColor(color);
  tft.setTextSize(size);
  tft.print("Settings");
};

void displayCam(int16_t x, int16_t y,uint8_t size, uint16_t color){
  tft.setCursor(x,y);
  tft.setTextColor(color);
  tft.setTextSize(size);
  tft.print("Cam");
};

void displayModoNoturno(int16_t x, int16_t y,uint8_t size, uint16_t color){
  tft.setCursor(x,y);
  tft.setTextColor(color);
  tft.setTextSize(size);
  tft.print("Modo Noturno");
};

void displayCalendario(int16_t x, int16_t y,uint8_t size, uint16_t color){
  tft.setCursor(x,y);
  tft.setTextColor(color);
  tft.setTextSize(size);
  tft.print("Calendario");
};

void displayHorario(int16_t x, int16_t y,uint8_t size, uint16_t color){
  tft.setCursor(x,y);
  tft.setTextColor(color);
  tft.setTextSize(size);
  tft.print("Horario");
};

void displayONorOFF(int16_t x, int16_t y,uint8_t size, uint16_t color){
  if(modoAlarme==0 && timemode==0 && luz==1){
    tft.setCursor(x,y);
    tft.setTextColor(color);
    tft.setTextSize(size);
    tft.print("OFF");
  }
  else{
    tft.setCursor(x,y);
    tft.setTextColor(color);
    tft.setTextSize(size);
    tft.print("ON");
  }  
};

void displayClock(){
  tft.fillRect(5,5,120,24,ST77XX_BLUE);
  //hours
  tft.setCursor(50,10);
  tft.setTextColor(ST77XX_WHITE);
  tft.setTextSize(1);
  tft.print(h);
  //:
  tft.setCursor(56,10);
  tft.setTextColor(ST77XX_WHITE);
  tft.setTextSize(1);
  tft.print(":");
  //minutes
  tft.setCursor(68,10);
  tft.setTextColor(ST77XX_WHITE);
  tft.setTextSize(1);
  tft.print(m);
}

void settingsMenu(){
  tft.fillScreen(ST77XX_BLUE);
  // Report
  tft.setCursor(10,30);
  tft.setTextColor(ST77XX_WHITE);
  tft.setTextSize(2);
  tft.print("Report");
  // OnlyNight Alarm ON
  tft.setCursor(10,60);
  tft.setTextColor(ST77XX_WHITE);
  tft.setTextSize(2);
  if(ldrmode==0){
    tft.print("Night OFF");
  }else tft.print("Night ON");
  // Clock
  tft.setCursor(10,90);
  tft.setTextColor(ST77XX_WHITE);
  tft.setTextSize(2);
  tft.print("Clock");
  //Back
  tft.setCursor(10, 110);
  tft.setTextColor(ST77XX_WHITE);
  tft.setTextSize(1);
  tft.print("Back");
}

void ReportMenu(){
  // Will show 10 last reports
  // Day 1/12/2222 Report movement at 08:20
  int ReportExit=0;
  tft.fillScreen(ST77XX_BLUE);
  //Back
  tft.setCursor(10,110);
  tft.setTextColor(ST77XX_WHITE);
  tft.setTextSize(1);
  tft.print("Back");
  int y=20;
  for(int i=0;i<ReportNum;i++){
        tft.setCursor(5,y);
        tft.setTextColor(ST77XX_WHITE);
        tft.setTextSize(1);
        tft.print("Date :");
        tft.print(ReportDay[i]);
        tft.print(" /12/2022");
        // Report movement at
        tft.setCursor(5,y+9);
        tft.setTextColor(ST77XX_WHITE);
        tft.setTextSize(1);
        tft.print("Report movement at:");
        // hours and mins
        tft.setCursor(5,y+18);
        tft.setTextColor(ST77XX_WHITE);
        tft.setTextSize(1);
        tft.print(ReportHour[i]);
        tft.setCursor(20,y+18);
        tft.setTextColor(ST77XX_WHITE);
        tft.setTextSize(1);
        tft.print(":");
        tft.setCursor(31,y+18);
        tft.setTextColor(ST77XX_WHITE);
        tft.setTextSize(1);
        tft.print(ReportMin[i]);
        y=y+40;   
  }
}



void startMenu(){
  tft.fillScreen(ST77XX_BLUE);
  displayAlarm(10,30,2,ST77XX_WHITE);
  displaySettings(10,70,2,ST77XX_WHITE);
  displayONorOFF(85,30,2,ST77XX_WHITE);
}

void displayClockSettings(){
  tft.fillScreen(ST77XX_BLUE);
  //Hours
  tft.setCursor(30,30);
  tft.setTextColor(ST77XX_WHITE);
  tft.setTextSize(2);
  tft.print(h);
  // :
  tft.setCursor(45,30);
  tft.setTextColor(ST77XX_WHITE);
  tft.setTextSize(2);
  tft.print(":");
  //Minutes
  tft.setCursor(58,30);
  tft.setTextColor(ST77XX_WHITE);
  tft.setTextSize(2);
  tft.print(m);
  //HoursI
  tft.setCursor(5,60);
  tft.setTextColor(ST77XX_WHITE);
  tft.setTextSize(2);
  tft.print(HauxI);
  // :
  tft.setCursor(25,60);
  tft.setTextColor(ST77XX_WHITE);
  tft.setTextSize(2);
  tft.print(":");
  //MinutesI
  tft.setCursor(33,60);
  tft.setTextColor(ST77XX_WHITE);
  tft.setTextSize(2);
  tft.print(MauxI);
  //Rect to chooce
  tft.drawRect(56,60,10,20,ST77XX_GREEN);
  if(timemode==1){
    tft.fillRect(57,61,9,19,ST77XX_WHITE);
  }else tft.fillRect(57,61,9,19,ST77XX_BLUE);
  //HoursF
  tft.setCursor(68,60);
  tft.setTextColor(ST77XX_WHITE);
  tft.setTextSize(2);
  tft.print(HauxF);
  // :
  tft.setCursor(92,60);
  tft.setTextColor(ST77XX_WHITE);
  tft.setTextSize(2);
  tft.print(":");
  //MinutesF
  tft.setCursor(100,60);
  tft.setTextColor(ST77XX_WHITE);
  tft.setTextSize(2);
  tft.print(MauxF);
  

  //Back
  tft.setCursor(20,100);
  tft.setTextColor(ST77XX_WHITE);
  tft.setTextSize(2);
  tft.print("back");
}

//Rect choose option
void rectClock(int posi){
  if(posi==0){
    displayClockSettings();
    tft.drawRect(22,28,12,10,ST77XX_RED);
  }
  if(posi==1){
    displayClockSettings();
    tft.drawRect(42,28,12,10,ST77XX_RED);
  }
  if(posi==2){ // aim to HauxI 
    displayClockSettings();
    tft.drawRect(2,58,20,20,ST77XX_RED);
  }
  if(posi==3){ // aim to MauxI 
    displayClockSettings();
    tft.drawRect(30,58,20,20,ST77XX_RED);
  }
  if(posi==4){ // aim to toggle timemode
    displayClockSettings();
    tft.drawRect(58,62,8,18,ST77XX_RED);
  }
  if(posi==5){ // aim to HauxF
    displayClockSettings();
    tft.drawRect(66,58,20,20,ST77XX_RED);
  }
  if(posi==6){ // aim to MauxF
    displayClockSettings();
    tft.drawRect(98,58,20,20,ST77XX_RED);
  }
  if(posi==7){ // aim to back
    displayClockSettings();
    tft.drawRect(20,98,60,24,ST77XX_RED);
  }
}

//Choice Clock Settings
int waitClock(unsigned long time){
  currentMillis=millis();
  unsigned long fim= currentMillis+time;
  while(currentMillis<fim){
    int checkAlarm = AlarmTime();
    Alarme(checkAlarm);
    //ldr
    if(ldrmode==1){
      int ldr=analogRead(A0);
      if(ldr<20){
        luz=0;
      }else luz=1;
    }else luz=1;
    if(digitalRead(botaoAlarm)){
      return 0;
    }
    if(digitalRead(botaoSettings)){
      return 1;
    }
    currentMillis=millis();
    
  }
  return 9;
}



// ALARM FUNCTIONS
void Alarme(int checkAlarm){
    int dist=measureDistance();
    if(modoAlarme==1){
      while(dist<30 && dist != 0){
        playNote(notes[0],beats[0]*tempo);
        dist=measureDistance();
        delay(1000);
        ReportHour[alarmNum]=h;
        ReportMin[alarmNum]=m;
        ReportDay[alarmNum]=d;
        ReportNum=ReportNum+1;
        alarmNum++;
        delay(1800);
      }
    }
    delay(100);
    if(timemode==1 && checkAlarm==1){
      int dist=measureDistance();
      while(dist<30 && dist != 0){
        playNote(notes[0],beats[0]*tempo);
        dist=measureDistance();
        delay(1000);
        ReportHour[alarmNum]=h;
        ReportMin[alarmNum]=m;
        ReportDay[alarmNum]=d;
        ReportNum=ReportNum+1;
        alarmNum++;
        delay(1800);
      }
    }
    if(luz==0){
      int dist=measureDistance();
      while(dist<30 && dist != 0){
        playNote(notes[0],beats[0]*tempo);
        dist=measureDistance();
      }
    }
    return;
}


int AlarmTime(){
  delay(50);
  if(HauxI==h && HauxF>=h){ // 7:30 < 7:40 < 11:00
    if(m>=MauxI){
      return 1;
    }
  }
  if(HauxI==h && HauxF==h){   // 7:30 < 7:55 < 7:56
    if(MauxI<=m && m<=MauxF){
      return 1;
    }
  }
  if(HauxI<=h && HauxF==h){ // 7:30 < 11:07 < 11:10
    if(m<=MauxF){
      return 1;
    }
  }
  if(HauxI<h){       // 7:30 < 8:20 < 11:10
    if(HauxF>h){
     return 1; 
    }
  }
  else return 0;

}

//WAIT FOR PRESS
bool detect_press(){
  static int buttonState = LOW; //initialize once in LOW
  bool pressed = false;
  int newbuttonState = digitalRead(botaoAlarm); //pressed->unpressed (button lifted)
  if (buttonState == HIGH && newbuttonState == LOW){
    //Serial.println("Press detected. Switch mode");
    switch_mode(); //change mode!
    pressed = true;
  }
  buttonState=newbuttonState; //keep track of button state
  return pressed;
}

void switch_mode(){
  if(modoAlarme == 0){
  modoAlarme = 1;
  }else{
  modoAlarme = 0;
}
}

int waitB(unsigned long time){
  currentMillis=millis();
  unsigned long fim= currentMillis+time;
  unsigned long agora = millis();
  //Serial.print("fimB:");
  //Serial.println(fim);
  while(currentMillis<fim){
    //ldr
    if(ldrmode==1){
      int ldr=analogRead(A0);
      if(ldr<20){
        luz=0;
      }else luz=1;
    }else luz=1;
    
    //CLOCK
    if(currentMillis>agora+1000){
      s=s+1;
      agora=millis();
      //Serial.print("seconds :");
      //Serial.println(s);
      if(s==60){
        s=0;
        m=m+1;
      }
    }
    if(m==60){
      m=0,
      h=h+1;
    }
    if(h==24){
      h=0;
      d=d+1;
    }
    
    // Trigger alarm if its on
    int checkAlarm = AlarmTime();
    Alarme(checkAlarm);
    
    displayClock();
    if(digitalRead(botaoAlarm)){
      return 0;
    }
    if(digitalRead(botaoSettings)){
      return 1;
    }
    currentMillis=millis();
    
  }
  return 9;
}


// 1 Waiting Menu choose 
int wait(unsigned long time){
  
  //DISPLAY START MENU and CLOCK , WAIT FOR A CHOICE 
  startMenu();

  

  currentMillis=millis();
  unsigned long fim= currentMillis+time;
  unsigned long agora = millis();
  while(currentMillis<fim){
    //ldr
    if(ldrmode==1){
      int ldr=analogRead(A0);
      if(ldr<20){
        startMenu();
        luz=0;
      }else luz=1;
      int x=0;
      while(x==0){
        startMenu();
        x=1;
      }
    }else luz=1;
    
    //CLOCK
    if(currentMillis>agora+1000){
      s=s+1;
      agora=millis();
      if(s==60){
        s=0;
        m=m+1;
      }
    }
    if(m==60){
      m=0,
      h=h+1;
    }
    if(h==24){
      h=0;
      d=d+1;
    }
    
    //Alarm function 
    int checkAlarm = AlarmTime();
    Alarme(checkAlarm);

    //Display and update clock
    displayClock();
    

    if(detect_press()){
      return 6;
    }
    if(digitalRead(botaoSettings)){
      return 7;
    }
    currentMillis=millis();
    
  }
  return 0;
}

// Rectangle sorround the option controlled by button
void rect(int pos){
  if(pos==0){
    settingsMenu();
    tft.drawRect(5,25,85,20,ST77XX_RED);
  }
  if(pos==1){
    settingsMenu();
    tft.drawRect(5,55,70,20,ST77XX_RED);
  }
  if(pos==2){
    settingsMenu();
    tft.drawRect(5,85,70,20,ST77XX_RED);
  }
  if(pos==3){
    settingsMenu();
    tft.drawRect(5,105,50,15,ST77XX_RED);
  }
}

//MAIN CODE
void loop() {
  //tft.drawRGBBitmap(0, 0, background, 480, 320);
  
  // Start Menu
  startMenu();


  //settingsMenu();
  //rect(0);
  
  // Start variables 
  int dist=measureDistance();
  int pos=0;
  int aguarde=0;
  int aguardeB=0;
  int endSettings=0;
  // Wait for a choice
  aguarde = wait(10000000); // will receive 6 if alarm button was press and 7 to go settings
  
  // Alarm mode is toggle on and off once the button is pressed
  int checkAlarm = AlarmTime();
  Alarme(checkAlarm);

  // In case you press settings button
  if(aguarde == 7){
    settingsMenu();
    //Now have to wait for another choice
    //This loop will only end when press choice is choosen
    while(endSettings==0){
      rect(pos);
      aguardeB=waitB(1000000);
      //change option with settings button
      if(aguardeB==1){
        pos=pos+1;
        if(pos==4){
          pos=0;
        }
      }
      //Serial.print("pos : ");
      //Serial.println(pos);
      // select option with alarm button
      if(aguardeB==0){
        if(pos==0){ // Report
          ReportMenu();
          int endReport=0;
          while(endReport==0){
            int choiceReport=waitB(50000);
            if(choiceReport==1){
              endReport=1;
            }
          }
        }
        if(pos==1){ // Night
          if(ldrmode==0){
            ldrmode=1;
          }else{
            ldrmode=0;
            luz=1;
          }
        }
        if(pos==2){ // Clock
          int posi=0, endClock=0;
          displayClockSettings(); //Show Clock Settings
          rectClock(posi); // Show where you are aiming
          while(endClock==0){
            int choiceClock=waitClock(50000);
            if(choiceClock==1){ // Next choice
              posi=posi+1;
              if(posi==8){
                posi=0;
              }
              rectClock(posi);
            }
            //Serial.print("posi: ");
            //Serial.println(posi);
            if(choiceClock==0){ // When you click to chance
              if(posi==0){
                h=h+1; //update hours
                if(h==24){
                  h=0;
                }
                displayClockSettings();
              }
              if(posi==1){
                m=m+1; // update minutes
                if(m==60){
                  m=0;
                }
                displayClockSettings();
              }
              if(posi==2){
                HauxI=HauxI+1;
                if(HauxI==24){
                  HauxI=0;
                }
                displayClockSettings();
              }
              if(posi==3){
                MauxI=MauxI+1;
                if(MauxI==60){
                  MauxI=0;
                }
                displayClockSettings();
              }
              if(posi==4){
                if(timemode==0){
                  timemode=1;
                }else timemode=0;
                tft.fillRect(57,61,9,19,ST77XX_WHITE);
                displayClockSettings();
              }
              if(posi==5){
                HauxF=HauxF+1;
                if(HauxF==24){
                  HauxF=0;
                }
                displayClockSettings();                
              }
              if(posi==6){
                MauxF=MauxF+1;
                if(MauxF==60){
                  MauxF=0;
                }
                displayClockSettings();
              }
              if(posi==7){
                endClock=1;
              }
            }
          }
        }
        if(pos==3){ // Back
          endSettings=1;
          startMenu();
        }
      }

    }
  }
}